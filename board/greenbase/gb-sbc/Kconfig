## board/greenbase/gb-sbc/Kconfig
```kconfig
if TARGET_GB_SBC

config SYS_BOARD
	default "gb-sbc"

config SYS_VENDOR
	default "greenbase"

config SYS_CONFIG_NAME
	default "gb-sbc"

endif
```

## configs/gb_sbc_defconfig
```kconfig
CONFIG_ARM=y
CONFIG_ARCH_HAILO=y
CONFIG_TARGET_GB_SBC=y
CONFIG_DEFAULT_DEVICE_TREE="gb-sbc"
CONFIG_SPI_FLASH_WINBOND=y
```

## configs/hailo15_veloce_defconfig
```kconfig
CONFIG_ARM=y
CONFIG_ARCH_HAILO=y
CONFIG_TARGET_HAILO15_VELOCE=y
CONFIG_DEFAULT_DEVICE_TREE="hailo15-veloce"
# CONFIG_ENV_IS_IN_MMC is not set
# CONFIG_SPL_ENV_IS_IN_MMC is not set
CONFIG_SPL_ENV_IS_NOWHERE=y
CONFIG_ENV_IS_NOWHERE=y
CONFIG_AUTOBOOT=y
CONFIG_BOOTCOMMAND="run bootargs_base bootargs_ram && bootm 0x87000000 0x89000000:0x5000000"
CONFIG_USE_BOOTCOMMAND=y
CONFIG_BOOTDELAY=0
CONFIG_SPL_RAM_SUPPORT=y
CONFIG_SPL_RAM_DEVICE=y
CONFIG_SUPPORT_RAW_INITRD=y
# CONFIG_AUTOBOOT_MENU_SHOW is not set
# CONFIG_CMD_BOOTMENU is not set
# CONFIG_MENU is not set
CONFIG_SYS_PROMPT="hailo15-veloce### "
```
