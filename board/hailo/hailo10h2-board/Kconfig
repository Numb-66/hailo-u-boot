## board/hailo/hailo10h2-board/Kconfig
```kconfig
if TARGET_HAILO10H2

config SYS_BOARD
	default "hailo10h2"

config SYS_VENDOR
	default "hailo"

config SYS_CONFIG_NAME
	default "hailo10h2"
	help
	  This option contains information about board configuration name.
	  Based on this option include/configs/<CONFIG_SYS_CONFIG_NAME>.h header
	  will be used for board configuration.

endif
```

## board/hailo/hailo10h2-veloce/Kconfig
```kconfig
if TARGET_HAILO10H2_VELOCE

config SYS_BOARD
	default "hailo10h2-veloce"

config SYS_VENDOR
	default "hailo"

config SYS_CONFIG_NAME
	default "hailo10h2-veloce"

endif
```

## board/hailo/hailo12l-evb/Kconfig
```kconfig
if TARGET_HAILO12L_EVB

config SYS_BOARD
	default "hailo12l-evb"

config SYS_VENDOR
	default "hailo"

config SYS_CONFIG_NAME
	default "hailo12l-evb"
	help
	  This option contains information about board configuration name.
	  Based on this option include/configs/<CONFIG_SYS_CONFIG_NAME>.h header
	  will be used for board configuration.

endif
```

## board/hailo/hailo12l-maple/Kconfig
```kconfig
if TARGET_HAILO12L_MAPLE

config SYS_BOARD
	default "hailo12l-maple"

config SYS_VENDOR
	default "hailo"

config SYS_CONFIG_NAME
	default "hailo12l-maple"
	help
	  This option contains information about board configuration name.
	  Based on this option include/configs/<CONFIG_SYS_CONFIG_NAME>.h header
	  will be used for board configuration.

endif
```

## board/hailo/hailo12l-veloce/Kconfig
```kconfig
if TARGET_HAILO12L_VELOCE

config SYS_BOARD
	default "hailo12l-veloce"

config SYS_VENDOR
	default "hailo"

config SYS_CONFIG_NAME
	default "hailo12l-veloce"

endif
```

## configs/hailo10_m2_defconfig
```kconfig
CONFIG_ARM=y
CONFIG_ARCH_HAILO=y
CONFIG_DEFAULT_DEVICE_TREE="hailo10-board-sku-0"
CONFIG_TARGET_HAILO10_M2=y
CONFIG_SUPPORT_RAW_INITRD=y
CONFIG_BOOTDELAY=0
CONFIG_SPL_OS_BOOT=y
CONFIG_SPL_RAM_SUPPORT=y
CONFIG_SPL_RAM_DEVICE=y
CONFIG_SPL_ENV_IS_NOWHERE=y
CONFIG_ENV_IS_NOWHERE=y
# CONFIG_SPL_DM_SPI is not set
# CONFIG_SPL_MMC is not set
# CONFIG_SPL_FS_FAT is not set
# CONFIG_SPL_SPI is not set
# CONFIG_SPL_DM_SPI_FLASH is not set
# CONFIG_SPL_NOR_SUPPORT is not set
# CONFIG_SPL_WATCHDOG is not set
# CONFIG_SPL_YMODEM_SUPPORT is not set
# CONFIG_CMD_BOOTMENU is not set
# CONFIG_SPL_EFI_PARTITION is not set
# CONFIG_ENV_IS_IN_SPI_FLASH is not set
# CONFIG_SPL_DM_SEQ_ALIAS is not set
# CONFIG_SPL_DM_MMC is not set
# CONFIG_CADENCE_QSPI is not set
# CONFIG_WATCHDOG is not set
# CONFIG_WDT is not set
# CONFIG_SPL_WDT is not set
```

## configs/hailo10_m2_devel_defconfig
```kconfig
CONFIG_ARM=y
CONFIG_ARCH_HAILO=y
CONFIG_TARGET_HAILO10_M2_DEVEL=y
CONFIG_DEFAULT_DEVICE_TREE="hailo10-m2-devel"
CONFIG_SUPPORT_RAW_INITRD=y
CONFIG_BOOTDELAY=0
CONFIG_SPL_OS_BOOT=y
CONFIG_SPL_RAM_SUPPORT=y
CONFIG_SPL_RAM_DEVICE=y
CONFIG_SPI_FLASH_ISSI=y
CONFIG_SPI_FLASH_WINBOND=y
CONFIG_SPI_FLASH_MACRONIX=y
CONFIG_CADENCE_QSPI=y
CONFIG_SPL_ENV_IS_NOWHERE=y
CONFIG_ENV_IS_NOWHERE=y
# CONFIG_SPL_MMC is not set
# CONFIG_SPL_FS_FAT is not set
# CONFIG_SPL_NOR_SUPPORT is not set
# CONFIG_SPL_WATCHDOG is not set
# CONFIG_SPL_YMODEM_SUPPORT is not set
# CONFIG_CMD_BOOTMENU is not set
# CONFIG_SPL_EFI_PARTITION is not set
# CONFIG_ENV_IS_IN_SPI_FLASH is not set
# CONFIG_SPL_DM_SEQ_ALIAS is not set
# CONFIG_SPL_DM_MMC is not set
# CONFIG_CADENCE_QSPI is not set
# CONFIG_WATCHDOG is not set
# CONFIG_WDT is not set
# CONFIG_SPL_WDT is not set
```

## configs/hailo10_usb_dongle_defconfig
```kconfig
CONFIG_ARM=y
CONFIG_ARCH_HAILO=y
CONFIG_TARGET_HAILO10_USB_DONGLE=y
CONFIG_DEFAULT_DEVICE_TREE="hailo10-usb-dongle"
CONFIG_SPI_FLASH_WINBOND=y
CONFIG_SPL_OS_BOOT=y
CONFIG_SPL_NOR_SUPPORT=y
CONFIG_SPL_LOAD_FIT=y
CONFIG_SPL_GZIP=y
# CONFIG_SPL_EFI_PARTITION is not set
# CONFIG_SPL_MMC is not set
# CONFIG_SPL_FS_FAT is not set
# CONFIG_SPL_YMODEM_SUPPORT is not set
# CONFIG_CMD_BOOTMENU is not set
# CONFIG_SPL_DM_SEQ_ALIAS is not set
# CONFIG_SPL_DM_MMC is not set
```

## configs/hailo10h2_board_defconfig
```kconfig
CONFIG_ARM=y
CONFIG_ARCH_HAILO=y
CONFIG_TARGET_HAILO10H2=y
CONFIG_DEFAULT_DEVICE_TREE="hailo10h2"
CONFIG_SPI_FLASH_STMICRO=y
```

## configs/hailo10h2_mint_defconfig
```kconfig
CONFIG_ARM=y
CONFIG_ARCH_HAILO=y
CONFIG_TARGET_HAILO10H2_MINT=y
CONFIG_DEFAULT_DEVICE_TREE="hailo10h2-mint"
CONFIG_SPI_FLASH_STMICRO=y
# CONFIG_ENV_IS_IN_MMC is not set
# CONFIG_SPL_ENV_IS_IN_MMC is not set
CONFIG_SPL_ENV_IS_NOWHERE=y
CONFIG_ENV_IS_NOWHERE=y
CONFIG_SPL_RAM_SUPPORT=y
CONFIG_SPL_RAM_DEVICE=y
CONFIG_SUPPORT_RAW_INITRD=y
```

## configs/hailo12l_evb_defconfig
```kconfig
CONFIG_ARM=y
CONFIG_ARCH_HAILO=y
CONFIG_TARGET_HAILO12L_EVB=y
CONFIG_DEFAULT_DEVICE_TREE="hailo12l-evb"
CONFIG_SPI_FLASH_STMICRO=y
CONFIG_SPL_ENV_IS_NOWHERE=y
CONFIG_ENV_IS_NOWHERE=y
CONFIG_SPL_RAM_SUPPORT=y
CONFIG_SPL_RAM_DEVICE=y
CONFIG_SUPPORT_RAW_INITRD=y
CONFIG_BOOTDELAY=0
```

## configs/hailo12l_maple_defconfig
```kconfig
CONFIG_ARM=y
CONFIG_ARCH_HAILO=y
CONFIG_TARGET_HAILO12L_MAPLE=y
CONFIG_DEFAULT_DEVICE_TREE="hailo12l-maple"
CONFIG_SPI_FLASH_STMICRO=y
# CONFIG_ENV_IS_IN_MMC is not set
# CONFIG_SPL_ENV_IS_IN_MMC is not set
CONFIG_SPL_ENV_IS_NOWHERE=y
CONFIG_ENV_IS_NOWHERE=y
CONFIG_SPL_RAM_SUPPORT=y
CONFIG_SPL_RAM_DEVICE=y
CONFIG_SUPPORT_RAW_INITRD=y
```

## configs/hailo15_sbc_rev3-1_defconfig
```kconfig
CONFIG_ARM=y
CONFIG_ARCH_HAILO=y
CONFIG_TARGET_HAILO15_SBC_REV3_1=y
CONFIG_DEFAULT_DEVICE_TREE="hailo15-sbc-rev3-1"
CONFIG_SPI_FLASH_ISSI=y
CONFIG_SPI_FLASH_MACRONIX=y
```

## configs/hailo15l_sbc_defconfig
```kconfig
CONFIG_ARM=y
CONFIG_ARCH_HAILO=y
CONFIG_TARGET_HAILO15L_SBC=y
CONFIG_DEFAULT_DEVICE_TREE="hailo15l-sbc"
CONFIG_SPI_FLASH_ISSI=y
CONFIG_SPL_LOAD_FIT_ADDRESS=0x70080000
CONFIG_DM_ETH_PHY=y
CONFIG_PHY_MSCC=y
CONFIG_RGMII=y
CONFIG_DM_MDIO=y
```
