// SPDX-License-Identifier: GPL-2.0
/*
 * dts file for Hailo15 SoC
 *
 * Copyright (c) 2019-2023 Hailo Technologies Ltd. All rights reserved.
 */

&hailo_boot_info {
    ddr_config {
        assembled_dram_pn = "MT53E1G32D2FW-046_regconfig_ca_odtb_pd_4GB";
    };
};
