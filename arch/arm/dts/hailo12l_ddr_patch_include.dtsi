// SPDX-License-Identifier: GPL-2.0
/*
 * dts file for Hailo12L ddr_MT53E1G32D2FW-046
 *
 * Copyright (c) 2019-2023 Hailo Technologies Ltd. All rights reserved.
 */

#include "hailo1x_ddr_MT53E1G32D2FW-046-B_regconfig_4GB_LP4X_patch.dtsi"