// SPDX-License-Identifier: GPL-2.0
/*
 * dts file for Hailo Hailo10 SoC
 *
 * Copyright (c) 2019-2024 Hailo Technologies Ltd. All rights reserved.
 */

#include "hailo15-base.dtsi"

&hailo_boot_info {
    product-id = <HAILO_PRODUCT_ID__10H>;
};
