// SPDX-License-Identifier: GPL-2.0
/*
 * dts file for Hailo10 (board-sku-5).
 *
 * Copyright (c) 2019-2025 Hailo Technologies Ltd. All rights reserved.
 */
#include "hailo10-m2-base.dtsi"
#include "hailo15_ddr_MT53E1G32D2FW-046_regconfig_ca_odtb_pu_4GB.dtsi"
