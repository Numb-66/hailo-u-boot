// SPDX-License-Identifier: GPL-2.0
/*
 * dts file for Hailo12L Mint SoC
 *
 * Copyright (c) 2019-2024 Hailo Technologies Ltd. All rights reserved.
 */

#include "hailo12l-base.dtsi"
#include "hailo15_ddr_configuration.dtsi"
#include "hailo1x_ddr_MT53E1G32D2FW-046-B_regconfig_4GB_LP4X.dtsi"

&hailo_boot_info {
    ddr_config {
        bist_enable = <0>;
    };
};
